## drivers/input/touchscreen/mediatek/AXS/Kconfig
```kconfig
config TOUCHSCREEN_MTK_AXS
	tristate "AXS15260 TDDI touch for Mediatek package"
	default n
	help
	  Say Y here if you have AXS15260 (AxsTech/爱协生) touch panel.
	  TDDI: display+touch single chip, I2C touch interface.
```

## drivers/misc/mediatek/lcm/Kconfig
```kconfig
config MTK_LCM
	bool "Enable LCM driver"
	default n
	help
	  define LCM driver config to enable LCM driver.
	  To set LCM driver which you choose avoid cannot driver LCM.
	  Please make sure CONFIG_MTK_LCM in xxxxxx_defconfig.mk.
	  And also make sure true on in ProjectConfig.mk

config CUSTOM_KERNEL_LCM
	string "define mediatek kernel LCM driver"
	help
	  To choose kernel LCM driver name.
	  This config is to select which LCM driver you want to use.
	  Please make sure CUSTOME_KERNEL_LCM in xxxxx_defconfig.mk.
	  And also make sure turn on in ProjectConfig.mk

config MTK_LCM_DEVICE_TREE_SUPPORT
	bool "support LCM device tree connect with display drivers"
	help
	  Decide whether to support LCM device tree based configuration.
	  This feature requires the connection between display driver and LCM devices.
	  Please also turn on MTK_LCM_DEVICE_TREE_SUPPORT in ProjectConfig.mk.
	  If not define MTK_LCM_DEVICE_TREE_SUPPORT
	  there will not connect between display driver and LCM devices.


config A25_LCM_POWER
	bool "A25 stock LCM bias and TPD reset sequence"
	depends on MACH_MT6765 && MTK_LCM && MTK_FB
	depends on I2C=y && OF && PINCTRL
	depends on TOUCHSCREEN_MTK=y && TOUCHSCREEN_MTK_AXS=y
	depends on !MTK_LCM_DEVICE_TREE_SUPPORT && !MTK_LEGACY
	depends on !FPGA_EARLY_PORTING
	depends on CUSTOM_KERNEL_LCM = "axs15260_dsi_6580_hd"
	default y
	help
	  Built-in-only supplier for the original A25 DT at address 0x3e.
	  Uses only stock register bytes, not a voltage conversion table.
	  Do not enable alongside another bias client/DT-LCM framework.
```

## drivers/misc/mediatek/sensors-1.0/accelerometer/mir3da/Kconfig
```kconfig
config MTK_MIR3DA
	bool "MiraMEMS MIR3DA experimental A25 candidate"
	depends on I2C && OF && MTK_SENSOR_SUPPORT && CUSTOM_KERNEL_ACCELEROMETER
	depends on !MTK_ACCELHUB && !NANOHUB && !CUSTOM_KERNEL_ACCELGYRO
	depends on MTK_SENSOR_ARCHITECTURE = "1.0"
	default n
	help
	  Teracube-derived candidate, not a verified A25 hardware profile.
	  No defconfig enabling. Runtime probe is also gated until explicit
	  lab approval; chip revision and calibration are unresolved.
	  The optional A25 virtual PS path has a separate owned sampler.

config MTK_MIR3DA_A25_STOCK_DIRECTION
	bool "A25-only: restore stock final MIR3DA direction 4"
	depends on MTK_MIR3DA
	default y
	help
	  A25 stock probe reads direction=6 from DT then overwrites it with 4.
	  Restore its final mounting transform (-X,+Y,-Z), not the DT input.
	  This driver candidate only accepts the A25 DT input/address contract.
	  Leave this enabled for A25; do not use as a generic MIR3DA setting.
	  Calibration, chip revision and hardware validation remain separate.

config MTK_MIR3DA_A25_STOCK_PIPELINE
	bool "A25-only: stock software compensation reconstruction"
	depends on MTK_MIR3DA_A25_STOCK_DIRECTION
	default y
	help
	  Use the parsed chip selector and machine-code-verified stock
	  30-sample stability / internal Z offset compensation for ACC data.
	  Factory raw reads stay raw. No PS registration or sampling owner
	  is added. Hardware validation and the existing lab opt-in remain.

config MTK_MIR3DA_A25_VIRTUAL_PS
	bool "A25-only: shared ACC/virtual proximity sampler"
	depends on MTK_MIR3DA_A25_STOCK_PIPELINE && PM_SLEEP
	default y
	help
	  Run a single compensated producer for ACC and virtual PS. Own the
	  PS endpoint independently of ALSPS context; arbitrate sensor minor
	  with physical ALSPS. PS holds a wakeup source because it has no IRQ.
	  This fixes the stock missing independent sampling path, not hardware
	  validation. MIR3DA's existing runtime hardware opt-in still applies.
```
